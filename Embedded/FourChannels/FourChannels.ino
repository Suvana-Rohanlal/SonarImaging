#include <ADC.h>
#include <DMAChannel.h>
#include <time.h>


#define BUFFER_SIZE 17000              //RAM can only handle this amount with both ADCs working      //   (2*10/343) - sample rate (range = 10m)
#define SAMPLE_RATE 500000                   // see below maximum values
#define SAMPLE_AVERAGING 0                  // 0, 4, 8, 16 or 32
#define SAMPLING_GAIN 1                     // 1, 2, 4, 8, 16, 32 or 64
#define SAMPLE_RESOLUTION 16                // 8, 10, 12 or 16 



// Main Loop Flow
#define CHECKINPUT_INTERVAL   50000         // 20 times per second
#define DISPLAY_INTERVAL      100000        // 10 times per second
#define SERIAL_PORT_SPEED     9600          // USB is always 12 Mbit/sec on teensy
#define DEBUG                 false

unsigned long lastInAvail;       //
unsigned long lastDisplay;       //
unsigned long lastBlink;         //
unsigned long currentTime;       //
unsigned long func_timer; // <<<<<<<<<<< Time execution of different functions
bool          STREAM  = false;
bool          VERBOSE = true;
bool          BINARY = true;
// I/O-Pins
const int readPin0             =  A0;
const int readPin1             = A13;
const int ledPin               = LED_BUILTIN;
int pinsADC0[2] = {A0, A15};//{A7, A6 };//
int pinsADC1[2] = {A16, A17};//{A19, A20};//

 int i;
 int l;
 int j;
 float m;
 int b;
 int a =0;
// int pin = A0;
 int val = 1000;
 int ch[1000];
 //char n[234] = {0x7f, 0x7f, 0x7f, 0x7f, 0x7f, 0x7f, 0x7f, 0x7f, 0x7f, 0x7f, 0x7f, 0x7f, 0x7f,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 0x7f, 0x7f};
 int ADC_Values [8380];
 int k;
 uint16_t bufferArray[4];
//ADC & DMA Config
ADC *adc = new ADC(); //adc object
DMAChannel dma0;
DMAChannel dma1;
// Variables for ADC0
DMAMEM static uint16_t buf_a[BUFFER_SIZE]; // buffer a
DMAMEM static uint16_t buf_b[BUFFER_SIZE]; // buffer b

// Variables for ADC1
DMAMEM static uint16_t buf_a1[BUFFER_SIZE]; // buffer a
DMAMEM static uint16_t buf_b1[BUFFER_SIZE]; // buffer b

volatile uint8_t          aorb_busy  = 0;      //
volatile uint8_t          a_full     = 0;      //
volatile uint8_t          b_full     = 0;      //


volatile uint8_t          aorb_busy1  = 0;      //
volatile uint8_t          a_full1     = 0;      //
volatile uint8_t          b_full1     = 0;      //

uint32_t                    freq     = SAMPLE_RATE;
uint8_t                     aver     = SAMPLE_AVERAGING;
uint8_t                      res     = SAMPLE_RESOLUTION;
uint8_t                    sgain     = SAMPLING_GAIN;
float                       Vmax     = 3.3;
ADC_REFERENCE               Vref     = ADC_REFERENCE::REF_3V3;
ADC_SAMPLING_SPEED    samp_speed     = ADC_SAMPLING_SPEED::VERY_HIGH_SPEED;
ADC_CONVERSION_SPEED  conv_speed     = ADC_CONVERSION_SPEED::VERY_HIGH_SPEED;

// Processing Buffer
uint16_t processed_buf[BUFFER_SIZE]; // processed data buffer
uint16_t processed_buf1[BUFFER_SIZE]; // processed data buffer

// Initialising the chirp pulse array
 int n[8380]= {2680, 2409, 2132, 1853, 1577, 1310, 1057, 823, 611, 426, 271, 149, 62,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 4061,
 4093, 4085, 4037, 3950, 3825, 3665, 3473, 3253, 3009, 2746, 2469, 2184,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 3796, 
3931, 4027, 4082, 4094, 4063, 3990, 3877, 3725, 3538, 3320, 3076, 2809,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 3566,
 3345, 3096, 2823, 2533, 2233, 1929, 1627, 1334, 1057, 802, 575, 380,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 2048
, 2048, 2048, 2048, 2048, 2048, 2048, 2048, 2048, 2048, 2048, 2048, 2048,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 2048, 2048};



//Chirp function
void sendChirp(){
  
  /* while(1)
          {
            float val = waveformsTable[wave0][i];
           // float rangeMultiplier = (desiredAmplitude*DACresolution)/refVoltage;
           // float out = val*rangeMultiplier; //1860 - range.amplitude of 1.5V, 1240 - range up to 1V, 2480 - range up to 2V 
           // float DACoffset = (desiredOffset*DACresolution)/refVoltage;
           // float newOut = out + DACoffset; //add offset (1860 = 1.5V) (1240 = 1V)
            analogWrite(A21, val);//newOut);  // write the selected waveform on DAC0
             // Serial.println(val);
            i++;
            if(i == numSamples)//maxSamplesNum) //2000)//used to be maxNumSamples
            {
              i = 0;
              counter++;
              if(counter==1) //change back to 5
              {
                //Serial.println("Sent");
                counter=0;
                break;
              }
            }
         
            sample = 1;//0.0001 //0.000025 //9
            delayMicroseconds(sample);  // Hold the sample value for the sample time
           }*/


  for(i=1;i<8380;i++){
    float out = 1.5 * n[i];
    analogWrite(A21,out); // writing to apin A21 of the teensy
   
   }
}


void setup() {
  pinMode(LED_BUILTIN, OUTPUT);
  pinMode(readPin0, INPUT); // Pin for the first receiver
  pinMode(readPin1, INPUT); // Pin for the second receiver 
  analogWriteResolution(12);
  // Setup monitor pin
  pinMode(ledPin, OUTPUT);
  digitalWriteFast(ledPin, LOW); // LED low, setup start

  while (!Serial && millis() < 3000) ;
  Serial.begin(Serial.baud());
  Serial.println("ADC Server (Minimal)");
  Serial.println("c to start conversion, p to print buffer");
  
  // clear buffers
  memset((void*)buf_a, 0, sizeof(buf_a));
  memset((void*)buf_b, 0, sizeof(buf_b));
  memset((void*)processed_buf, 0, sizeof(buf_b));


    // clear buffers
  memset((void*)buf_a1, 0, sizeof(buf_a1));
  memset((void*)buf_b1, 0, sizeof(buf_b1));
  memset((void*)processed_buf1, 0, sizeof(buf_b1));
  // LED on, setup complete
  digitalWriteFast(ledPin, HIGH);

}// setup =========================================================

int          inByte   = 0;
String inNumberString = "";
long         inNumber = -1;
boolean   chunk1_sent = false;
boolean   chunk2_sent = false;
boolean   chunk3_sent = false;


void dma0_isr_single(void) {
  aorb_busy = 0;
     a_full = 1;
  dma0.clearInterrupt(); // takes more than 0.5 micro seconds
  dma0.clearComplete(); // takes about ? micro seconds
}


void dma1_isr_single(void) {
  aorb_busy1 = 0;
     a_full1 = 1;
  dma1.clearInterrupt(); // takes more than 0.5 micro seconds
  dma1.clearComplete(); // takes about ? micro seconds
}

// ADC
void setup_ADC_single(void) {
  // clear buffers
  memset((void*)buf_a, 0, sizeof(buf_a));
  memset((void*)buf_a1, 0, sizeof(buf_a1));
  // Initialize the ADC 0
//  if (sgain >1) { adc->enablePGA(sgain, ADC_0); }  else { adc->disablePGA(ADC_0); }         
  adc->adc0->setReference(Vref);
  adc->adc0->setAveraging(aver); 
  adc->adc0->setResolution(res); 
  if (((Vref == ADC_REFERENCE::REF_3V3) && (Vmax > 3.29)) || ((Vref == ADC_REFERENCE::REF_1V2) && (Vmax > 1.19))) { 
    adc->adc0->disableCompare();
  } else if (Vref == ADC_REFERENCE::REF_3V3) {
    adc->adc0->enableCompare(Vmax/3.3*adc->adc0->getMaxValue(), 0);
  } else if (Vref == ADC_REFERENCE::REF_1V2) {
    adc->adc0->enableCompare(Vmax/1.2*adc->adc0->getMaxValue(), 0);    
  }
  //adc->enableCompareRange(1.0*adc->getMaxValue(ADC_1)/3.3, 2.0*adc->getMaxValue(ADC_1)/3.3, 1, 1, ADC_1); // ready if value lies out of [1.0,2.0] V
  adc->adc0->setConversionSpeed(conv_speed);
  adc->adc0->setSamplingSpeed(samp_speed);      

  // Initialize dma
  dma0.source((volatile uint16_t&)ADC0_RA);
  dma0.destinationBuffer(buf_a, sizeof(buf_a));
  dma0.triggerAtHardwareEvent(DMAMUX_SOURCE_ADC0);
  dma0.interruptAtCompletion();
  //dma0.disableOnCompletion();
  dma0.attachInterrupt(&dma0_isr_single);


    // Initialize the ADC 1
//  if (sgain >1) { adc->enablePGA(sgain, ADC_0); }  else { adc->disablePGA(ADC_0); }         
  adc->adc1->setReference(Vref);
  adc->adc1->setAveraging(aver); 
  adc->adc1->setResolution(res); 
  if (((Vref == ADC_REFERENCE::REF_3V3) && (Vmax > 3.29)) || ((Vref == ADC_REFERENCE::REF_1V2) && (Vmax > 1.19))) { 
    adc->adc1->disableCompare();
  } else if (Vref == ADC_REFERENCE::REF_3V3) {
    adc->adc1->enableCompare(Vmax/3.3*adc->adc1->getMaxValue(), 0);
  } else if (Vref == ADC_REFERENCE::REF_1V2) {
    adc->adc1->enableCompare(Vmax/1.2*adc->adc1->getMaxValue(), 0);    
  }
  //adc->enableCompareRange(1.0*adc->getMaxValue(ADC_1)/3.3, 2.0*adc->getMaxValue(ADC_1)/3.3, 1, 1, ADC_1); // ready if value lies out of [1.0,2.0] V
  adc->adc1->setConversionSpeed(conv_speed);
  adc->adc1->setSamplingSpeed(samp_speed);      

  // Initialize dma
  dma1.source((volatile uint16_t&)ADC1_RA);
  dma1.destinationBuffer(buf_a1, sizeof(buf_a1));
  dma1.triggerAtHardwareEvent(DMAMUX_SOURCE_ADC1);
  dma1.interruptAtCompletion();
  //dma0.disableOnCompletion();
  dma1.attachInterrupt(&dma1_isr_single);
}

void start_ADC(int readPin0, int readPin1) {
    // Start adc 0
    aorb_busy  = 1;
    a_full    = 0;
    b_full    = 0;
    adc->adc0->startSingleRead(readPin0);
    // frequency, hardware trigger and dma
    adc->adc0->startPDB(freq); // set ADC_SC2_ADTRG
    adc->adc0->enableDMA(); // set ADC_SC2_DMAEN
    dma0.enable();

    // Start adc 1
    aorb_busy1  = 1;
    a_full1    = 0;
    b_full1    = 0;
    adc->adc1->startSingleRead(readPin1);
    // frequency, hardware trigger and dma
    adc->adc1->startPDB(freq); // set ADC_SC2_ADTRG
    adc->adc1->enableDMA(); // set ADC_SC2_DMAEN
    dma1.enable();
}

void stop_ADC(void) {
    PDB0_CH0C1 = 0; // diasble ADC0 pre triggers    
    dma0.disable();
    adc->adc0->disableDMA();
    adc->adc0->stopPDB();
    aorb_busy = 0;

     PDB0_CH1C1 = 0; // diasble ADC1 pre triggers    
    dma1.disable();
    adc->adc1->disableDMA();
    adc->adc1->stopPDB();
    aorb_busy1 = 0;
}

void wait_ADC_single() {
  uint32_t   end_time = micros();
  uint32_t start_time = micros();
  while (!a_full) {
    end_time = micros();
    if ((end_time - start_time) > 1100000) {
      Serial.printf("Timeout %d %d\n", a_full, aorb_busy);
      break;
    }
  }
 Serial.printf("0");
}



// CONVERT FLOAT TO HEX AND SEND OVER SERIAL PORT
void serialFloatPrint(float f) {
  byte * b = (byte *) &f;
  for(int i=3; i>=0; i--) {
    
    byte b1 = (b[i] >> 4) & 0x0f;
    byte b2 = (b[i] & 0x0f);
    
    char c1 = (b1 < 10) ? ('0' + b1) : 'A' + b1 - 10;
    char c2 = (b2 < 10) ? ('0' + b2) : 'A' + b2 - 10;
    
    Serial.print(c1);
    Serial.print(c2);
  }
}

// CONVERT Byte TO HEX AND SEND OVER SERIAL PORT
void serialBytePrint(byte b) {
  byte b1 = (b >> 4) & 0x0f;
  byte b2 = (b & 0x0f);

  char c1 = (b1 < 10) ? ('0' + b1) : 'A' + b1 - 10;
  char c2 = (b2 < 10) ? ('0' + b2) : 'A' + b2 - 10;

  Serial.print(c1);
  Serial.print(c2);
}

// CONVERT 16BITS TO HEX AND SEND OVER SERIAL PORT
void serial16Print(uint16_t u) {
  byte * b = (byte *) &u;
  for(int i=1; i>=0; i--) {
    
    byte b1 = (b[i] >> 4) & 0x0f;
    byte b2 = (b[i] & 0x0f);
    
    char c1 = (b1 < 10) ? ('0' + b1) : 'A' + b1 - 10;
    char c2 = (b2 < 10) ? ('0' + b2) : 'A' + b2 - 10;
    
    Serial.print(c1);
    Serial.print(c2);
  }
}

// CONVERT Long TO HEX AND SEND OVER SERIAL PORT
void serialLongPrint(unsigned long l) {
  byte * b = (byte *) &l;
  for(int i=3; i>=0; i--) {
    
    byte b1 = (b[i] >> 4) & 0x0f;
    byte b2 = (b[i] & 0x0f);
    
    char c1 = (b1 < 10) ? ('0' + b1) : 'A' + b1 - 10;
    char c2 = (b2 < 10) ? ('0' + b2) : 'A' + b2 - 10;
    
    Serial.print(c1);
    Serial.print(c2);
  }
}


void printBuffer(uint16_t *buffer, size_t start, size_t end) {
  size_t i;
  if (VERBOSE) {
    for (i = start; i <= end; i++) { delayMicroseconds(31); Serial.println(buffer[i]); }
  } else {
    for (i = start; i <= end; i++) {
      serial16Print(buffer[i]);
      Serial.println(); }
  }
}

void print2Buffer(uint16_t *buffer1,uint16_t *buffer2, size_t start, size_t end) {
  size_t i;
  if (VERBOSE) {
    
    for (i = start; i <= end; i++) { 
      clock_t tic = clock();
      Serial.print(buffer1[i]); 
      Serial.print(","); 
      Serial.println(buffer2[i]);
      clock_t toc = clock();
      double elapsed = (double)(toc-tic)*1000.0/ CLOCKS_PER_SEC;
      }
  } else if (BINARY) {
    for (i = start; i <= end; i++) {
      byte* byteData1 = (byte*) buffer1[i];
      byte* byteData2 = (byte*) buffer2[i];
      byte buf[5] = {byteData1[0],byteData1[1],byteData2[0],byteData2[1],'\n'};
      Serial.write(buf,5);
    }
  } else {
    for (i = start; i <= end; i++) {
      serial16Print((buffer1[i]));
      Serial.print(",");
      serial16Print((buffer2[i]));
      Serial.println(",");
    }
  }
}
// Debug ===========================================================

typedef struct  __attribute__((packed, aligned(4))) {
  uint32_t SADDR;
  int16_t SOFF;
  uint16_t ATTR;
  uint32_t NBYTES;
  int32_t SLAST;
  uint32_t DADDR;
  int16_t DOFF;
  uint16_t CITER;
  int32_t DLASTSGA;
  uint16_t CSR;
  uint16_t BITER;
} TCD_DEBUG;

void dumpDMA_TCD(const char *psz, DMABaseClass *dmabc)
{
  Serial.printf("%s %08x %08x:", psz, (uint32_t)dmabc, (uint32_t)dmabc->TCD);
  TCD_DEBUG *tcd = (TCD_DEBUG*)dmabc->TCD;
  Serial.printf("%08x %04x %04x %08x %08x ", tcd->SADDR, tcd->SOFF, tcd->ATTR, tcd->NBYTES, tcd->SLAST);
  Serial.printf("%08x %04x %04x %08x %04x %04x\n", tcd->DADDR, tcd->DOFF, tcd->CITER, tcd->DLASTSGA,
                tcd->CSR, tcd->BITER);

}


int bufs=0;
void loop() { // ===================================================

  // Keep track of loop time
  currentTime = micros();
  if ((currentTime-lastInAvail) >= CHECKINPUT_INTERVAL) {
    lastInAvail = currentTime;
    if (Serial.available()) {
      inByte=Serial.read();
      if (inByte == 'c') { // single block conversion
         //for(int k=0; k<2; k++){
          if ((aorb_busy == 1) || (aorb_busy == 2)) { stop_ADC(); }
          //readPin0;
          setup_ADC_single();
          start_ADC(pinsADC0[0], pinsADC1[0]);
          sendChirp(); // calling chirp pulse function
          wait_ADC_single();
          stop_ADC();
         // adc->printError();
          adc->resetError(); 

         /* bufferArray[bufs] = buf_a;
          bufs++;
          bufferArray[bufs] = buf_a1;
          bufs++;*/
         
        // }  
        }

         else if (inByte == 'd') { // single block conversion
         //for(int k=0; k<2; k++){
          if ((aorb_busy == 1) || (aorb_busy == 2)) { stop_ADC(); }
          //readPin0;
          setup_ADC_single();
          start_ADC(pinsADC0[1], pinsADC1[1]);
          sendChirp(); // calling chirp pulse function
          wait_ADC_single();
          stop_ADC();
         // adc->printError();
          adc->resetError(); 

         /* bufferArray[bufs] = buf_a;
          bufs++;
          bufferArray[bufs] = buf_a1;
          bufs++;*/
         
        // }  
        }
      
      else if (inByte == 'p') { // print buffer
          printBuffer(buf_a, 0, BUFFER_SIZE-1);
      }
       else if (inByte == 'x') { // print buffer
          printBuffer(buf_a1, 0, BUFFER_SIZE-1);
      }
         /*else if (inByte == 'x') { // print buffer
          printBuffer(bufferArray[2], 0, BUFFER_SIZE-1);
      }
      else if (inByte == 's') { // print buffer
          printBuffer(bufferArray[3], 0, BUFFER_SIZE-1);
      }*/
     
    }
  
      
    } // end if serial input available
 // end check serial in time interval
    
  if ((currentTime-lastDisplay) >= DISPLAY_INTERVAL) {
    lastDisplay = currentTime;
//    adc->printError();
    adc->resetError();
  } 
    
  

} // end loop ======================================================
